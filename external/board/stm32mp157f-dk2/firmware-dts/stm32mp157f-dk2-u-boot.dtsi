// SPDX-License-Identifier: (GPL-2.0+ OR BSD-3-Clause)
#include "stm32mp157c-dk2-u-boot.dtsi"

/* U-Boot 2024.07 uses the C compatible to run DK2 board setup. */
/ {
	compatible = "st,stm32mp157f-dk2", "st,stm32mp157c-dk2", "st,stm32mp157";
};
